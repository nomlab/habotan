## main/Kconfig.projbuild
```kconfig
menu "Habotan Configuration"

config WIFI_SSID
    string "WiFi SSID"
	default "myssid"
	help
		SSID (network name) for the example to connect to.

config WIFI_PASSWORD
    string "WiFi Password"
	default "mypassword"
	help
		WiFi password (WPA or WPA2) for the example to use.

		Can be left blank if the network has no security set.

config TRIGGER_BUTTON_GPIO
    int "Trigger Button GPIO number"
	range 0 39
	default 4
	help
		GPIO number (IOxx) connected to trigger push-button.

		Some GPIOs are used for other purposes (flash connections, etc.) and cannot be used.

config SLACK_API_ENDPOINT
    string "Slack API postMessage Endpoint"
	default "https://slack.com/api/chat.postMessage"
	help
		Slack API postMessage Endpoint.

		In most case, you do not have to change this value.
		You can change if you need to test using another site.

config SLACK_API_TOKEN
    string "Slack API Token"
	default "xoxp-XXXXXX..."
	help
		Slack legacy token.

		You can get your legacy token from after logged in:
		  https://api.slack.com/custom-integrations/legacy-tokens
		Never share legacy tokens with others !!!

config SLACK_CHANNEL_NAME
    string "Slack Channel Name to Post"
	default "general"
	help
		Slack channel name to post.

		For example general, random, etc..

config SLACK_MESSAGE
    string "Slack Message to Post"
	default "Hello!"
	help
		Message to post when connected to Slack.

endmenu
```
